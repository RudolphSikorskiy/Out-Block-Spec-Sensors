#include "SoftUART.h"
#define BufLEN 200

uint8_t n=0;						// Курсор масива
char instr[BufLEN];					// Буфер приема
char BUF[BufLEN];
uint8_t Ok[] = "OK!";				// Буфер приема


//--------------------------------------------------------------------------------------------//

ISR(INT0_vect)
{
	GICR&=~(1<<6);						//отключаем прерывание по INT0
	MCUCR&=~(1<<1);						//отключаем прерывание по ниспадающему фронту сигнала на INT0  MLN/BTREIT/2
	_delay_us(MLN/BTREIT/2);
	if (!CheckBit(PIND,RX_PIN))			//n=PIND&(1<<RX_PIN);
	{
		uint8_t x = SOFT_UART_read();
		instr[n] = x;
		//USART_Transmit(x);
		n++;
		
		if(n>BufLEN) n=0;					//проверка переполнени¤ массива
	}
	
	//-----------------------------------------------------------------------------------------------------//
	
	
	
	//-----------------------------------------------------------------------------------------------------//
	
	GICR|=(1<<6);						//разрешаем прерывание по INT0
	MCUCR|=(1<<1);						//прерывание по ниспадающему фронту сигнала на INT0
}

//--------------------------------------------------------------------------------------------//

void SOFT_UART_byte( char a)			// отправка байта
{
	SOFT_UART_bit(0x00);//start bit
	for (int i = 0; i < 8; i++)
	{
		if ((a >> i) & 0x01)
		{
			SOFT_UART_bit(0x01);//data bit
		}
		else
		{
			SOFT_UART_bit(0x00);//data bit
		}
	}
	SOFT_UART_bit(0x01);//stop bit
}

//--------------------------------------------------------------------------------------------//

void SOFT_UART_init(void)					// Инициализация Програмного порта
{
	DDRD |=(1<<TX_PIN);
	PORTD |=(1<<TX_PIN);
	DDRD &= ~(1<<RX_PIN);
	GICR|=(1<<6);   //разрешаем прерывание по INT0
	MCUCR|=(1<<1); //прерывание по ниспадающему фронту сигнала на INT0

}

//--------------------------------------------------------------------------------------------//

void SOFT_UART_bit(char b)			//отправка бита
{
	if (b == 0x00)
	{
		PORTD &= ~(1<<TX_PIN);
	}
	_delay_us(MLN/BTREIT);
	PORTD |= (1<<TX_PIN);
}

//--------------------------------------------------------------------------------------------//

void SOFT_UART_send( char *str)		//отправка слова
{
	unsigned char i=0;
	while (str[i])
	{
		SOFT_UART_byte(str[i++]);
	}
}

//--------------------------------------------------------------------------------------------//

unsigned char SOFT_UART_read(void)			// прием строки
{
	char i;
	unsigned char ch=0;
	for(i=0;i<8;i++)
	{
		_delay_us(MLN/BTREIT);
		if(CheckBit(PIND,RX_PIN)) ch|= 1<<i;
	}
	return ch;


}

//--------------------------------------------------------------------------------------------//



//--------------------------------------------------------------------------------------------//

char *OperationResponse(void)				// Возврат строки полученной при прерывании
{
	//SOFT_UART_byte(command);
	/*_delay_ms(10);
	SOFT_UART_byte(comand);					// Отправка запроса данных*/
	//USART_Transmit_str(instr);
	
	memcpy(BUF, instr, sizeof(BUF));
	
	
	
//--------------------------------------------------------------------------------------------//

	n=0;
	//instr[0] = '\0';
	return BUF;
	
}

//--------------------------------------------------------------------------------------------//